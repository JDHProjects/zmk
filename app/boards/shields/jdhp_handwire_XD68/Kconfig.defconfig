## app/boards/shields/jdhp_handwire_XD68/Kconfig.defconfig
```kconfig
if SHIELD_JDHP_HANDWIRE_XD68

config ZMK_KEYBOARD_NAME
	default "Joshs XD68"

endif
```

## app/boards/shields/jdhp_handwire_XD68/Kconfig.shield
```kconfig
config SHIELD_JDHP_HANDWIRE_XD68
	def_bool $(shields_list_contains,jdhp_handwire_xd68)
```
